## br_output/defconfig
```kconfig
BR2_arm=y
BR2_cortex_a53=y
BR2_TOOLCHAIN_EXTERNAL=y
BR2_TOOLCHAIN_EXTERNAL_CUSTOM=y
BR2_TOOLCHAIN_EXTERNAL_CUSTOM_PREFIX="armv8-rpi3-linux-gnueabihf"
BR2_TOOLCHAIN_EXTERNAL_GCC_8=y
BR2_TOOLCHAIN_EXTERNAL_HEADERS_4_14=y
BR2_TOOLCHAIN_EXTERNAL_CUSTOM_GLIBC=y
BR2_TOOLCHAIN_EXTERNAL_CXX=y
BR2_TOOLCHAIN_EXTERNAL_GDB_SERVER_COPY=y
BR2_PACKAGE_DROPBEAR=y
```

## yocto/build/conf/bblayers.conf
```bitbake
# POKY_BBLAYERS_CONF_VERSION is increased each time build/conf/bblayers.conf
# changes incompatibly
POKY_BBLAYERS_CONF_VERSION = "2"

BBPATH = "${TOPDIR}"
BBFILES ?= ""

BBLAYERS ?= " \
  /home/ubuntu/Desktop/smartcam/yocto/poky/meta \
  /home/ubuntu/Desktop/smartcam/yocto/poky/meta-poky \
  /home/ubuntu/Desktop/smartcam/yocto/poky/meta-yocto-bsp \
  /home/ubuntu/Desktop/smartcam/yocto/poky/../meta-raspberrypi \
  /home/ubuntu/Desktop/smartcam/yocto/poky/../meta-smartcam \
  "

BB_NUMBER_THREADS ?= "${@oe.utils.cpu_count()}"
PARALLEL_MAKE ?= "-j ${@oe.utils.cpu_count()}"
```

## yocto/meta-smartcam/conf/layer.conf
```bitbake
# We have a conf and classes directory, add to BBPATH
BBPATH .= ":${LAYERDIR}"

# We have recipes-* directories, add to BBFILES
BBFILES += "${LAYERDIR}/recipes-*/*/*.bb \
            ${LAYERDIR}/recipes-*/*/*.bbappend"

BBFILE_COLLECTIONS += "meta-smartcam"
BBFILE_PATTERN_meta-smartcam = "^${LAYERDIR}/"
BBFILE_PRIORITY_meta-smartcam = "10"

LAYERDEPENDS_meta-smartcam = "core"
LAYERSERIES_COMPAT_meta-smartcam = "warrior zeus"
```
